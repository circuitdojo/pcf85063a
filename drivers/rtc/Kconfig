## drivers/rtc/Kconfig
```kconfig
#
# Copyright (c) 2022 Circuit Dojo LLC
#
# SPDX-License-Identifier: Apache-2.0
#

menuconfig PCF85063A
	bool "PCF85063A Real Time Clock"
	default y
	depends on DT_HAS_NXP_PCF85063A_ENABLED
	select I2C
	select RTC
	help
	  Enable SPI/I2C-based driver for PCF85063A based RTC
```

## dts/bindings/rtc/nxp,pcf8563.yaml
```yaml
#
# Copyright (c) 2022 Circuit Dojo LLC
# SPDX-License-Identifier: Apache-2.0
#

description: NXP PCF85063A Real Time Clock

compatible: "nxp,pcf85063a"

include:
  - name: rtc-device.yaml
  - name: i2c-device.yaml

properties:
  int1-gpios:
    type: phandle-array
    description: |
      GPIO connected to the PC85063A INT1 interrupt output. This signal is open-drain, active low.
```
